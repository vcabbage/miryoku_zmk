// Copyright 2021 Manna Harbour
// https://github.com/manna-harbour/miryoku

#include "../miryoku/custom_config.h"
#include "../miryoku/mapping/54/levels54.h"
#include "../miryoku/miryoku.dtsi"

/*
#include <behaviors.dtsi>
#include <dt-bindings/zmk/bt.h>
#include <dt-bindings/zmk/keys.h>
#include <dt-bindings/zmk/outputs.h>
#include <dt-bindings/zmk/pointing.h>

/ {
    keymap {
        compatible = "zmk,keymap";
        default_layer {
            display-name = "Base";
            bindings = <
                &kp TILDE &kp N1 &kp N2 &kp N3 &kp N4 &kp N5   &kp N6 &kp N7  &kp N8     &kp N9   &kp N0    &kp GRAVE
                &kp TAB   &kp Q  &kp W  &kp E  &kp R  &kp T    &kp Y &kp U  &kp I     &kp O   &kp P    &kp BSPC
                &kp LCTRL &kp A  &kp S  &kp D  &kp F  &kp G    &kp H &kp J  &kp K     &kp L   &kp SEMI &kp SQT
                &kp LSHFT &kp Z  &kp X  &kp C  &kp V  &kp B    &kp N &kp M  &kp COMMA &kp DOT &kp FSLH &kp ESC
                            &lt 3 LGUI &mo 1 &kp SPACE   &kp RET &mo 2 &kp RALT
            >;
        };

        lower_layer {
            display-name = "Lower";
            bindings = <
                &kp TILDE &kp N1 &kp N2 &kp N3 &kp N4 &kp N5   &kp N6 &kp N7  &kp N8     &kp N9   &kp N0    &kp GRAVE
                &kp TAB    &kp N1       &kp N2       &kp N3       &kp N4       &kp N5         &kp N6   &kp N7   &kp N8 &kp N9    &kp N0 &kp BSPC
                &bt BT_CLR &bt BT_SEL 0 &bt BT_SEL 1 &bt BT_SEL 2 &bt BT_SEL 3 &bt BT_SEL 4   &kp LEFT &kp DOWN &kp UP &kp RIGHT &trans &trans
                &kp LSHFT  &trans       &trans       &trans       &trans       &trans         &trans   &trans   &trans &trans    &trans &trans
                                            &lt 3 LGUI     &trans       &kp SPACE      &kp RET  &trans   &kp RALT

            >;
        };

        raise_layer {
            display-name = "Raise";
            bindings = <
                &kp TILDE &kp N1 &kp N2 &kp N3 &kp N4 &kp N5   &kp N6 &kp N7  &kp N8     &kp N9   &kp N0    &kp GRAVE
                &kp  TAB  &kp EXCL &kp AT &kp HASH &kp DLLR &kp PRCNT   &kp CARET &kp AMPS  &kp KP_MULTIPLY &kp LPAR &kp RPAR &kp BSPC
                &kp LCTRL &trans   &trans &trans   &trans   &trans      &kp MINUS &kp EQUAL &kp LBKT        &kp RBKT &kp BSLH &kp GRAVE
                &kp LSHFT &trans   &trans &trans   &trans   &trans      &kp UNDER &kp PLUS  &kp LBRC        &kp RBRC &kp PIPE &kp TILDE
                                        &lt 3 LGUI &trans   &kp SPACE   &kp RET   &trans    &kp RALT
            >;
        };

        mouse_layer {
            display-name = "Mouse";
            bindings = <
                &trans &trans  &trans     &trans     &trans     &trans  &trans  &trans  &trans  &trans  &trans &trans
                &trans &trans  &trans     &trans     &trans     &trans  &trans  &trans  &trans  &trans  &trans &trans
                &trans &trans  &mkp RCLK  &mkp MCLK  &mkp LCLK  &trans  &trans  &trans  &trans  &trans  &trans &trans
                &trans &trans  &trans     &trans     &trans     &trans  &trans  &trans  &trans  &trans  &trans &trans
                                &trans     &trans     &trans  &trans  &trans  &trans
            >;
        };
    };
};
*/
